;VARREDURA X INTTERUPÇÃO 
;SUPONDO UM PWM QUE DEVE SER INCEMENTADO A CADA INSTATE DE TEMPO
; DEPENDA DE UM BTN(DE VARREDURA) PAARA COMESSAR POR ENQUANTO ESSE INCREMENTO DE PWM NÃO É INICIADO 
; A INTERRUPÇÃO PODERIA INICIAR O INCREMNTO A QUALQUER MOMENTO INDEPENDETE DO TAMANHO DO PWM OU FUÇÃO ANTERIOR, DIFERENTE O BTN QUE NA MELHOR HIPOTESE
; PRECISA ESPERAR UM CICLO INTEIRO PRA VERIFICAR O BTN CASO NÃO TRAVASSE ESSA VERIFICAÇÃO EM UM LOOP

	PWM 	EQU	P2.0
	BTNV	EQU	P2.7
	BTNI	EQU	P3.2

	ORG	0000H
	JMP	CONFIG

	ORG	0003H
	SETB	AC	
	RETI

CONFIG:
	SETB	BTNV
	SETB	BTNI
	MOV  	IE,#10000001B
	MOV 	IP,#00000001B
	MOV	TCON,#00H
	MOV	R7,#00H
	MOV	R6,#22H		;34 MAX DE N VEZES VARIAÇÕES
	MOV 	R5,#00H

LOOP:
	
	CALL 	PULSO		;(COLOQUEI DESSA FORMA PRA EVITAR MAIORES ERROS DE TEMPO COM DJNZ)
	CALL 	PULSO		;
	CALL 	PULSO		;
	CALL 	PULSO		;
	CALL 	PULSO		;
	CALL 	PULSO		;
	CALL 	PULSO		;
	CALL 	PULSO		;
	CALL 	PULSO		;
	CALL 	PULSO		;	
	CALL 	PULSO		; 10 PULSOS = 200MS PRA CADA INCREMENTO 

	JB	AC,AUXLOOP	;VERIFICA SE ESTA EM MODO DE INCREMENTO
	JB	BTNV, LOOP	;FAZ A VARREDURA(QUE É DEPENDENTE DO TIMER DO PULSO DIFERENTE DE INTERRUPÇÃO)
	SETB	AC		;ENTRA EM MODO DE INCREMENTO CASO FOR 
	JMP 	LOOP
AUXLOOP:
	CALL	INCREMENTA 
	INC	R5		;
	CJNE	R5,#22H,LOOP	; VERIFICA SE JA INCREMENTOU O MAXIMO	
	MOV	R7,#00H
	MOV	R6,#22H		;RESTAURA
	CLR	AC		; GRAU ZERO ATE QUE PEÇA PARA SER INICIADO
	JMP	LOOP


;DUTY VAI VARIAR 0,5 - 2,4  n*0,056 PODENDO IR ATÉ N = 34
; COMO O DUTY VAI VARIA APENAS 1,9 E JA TEM O NATURAL DE 0,5
; O DUTY negativo vai ter um tempo fixo de 17,6 podendo tbm varia de 0 - 1,9  no duty contrario

PULSO:
positivo:
	setb	PWM
	MOV	r0,#0f9h	;0.5MS natural ativo
 	DJNZ	r0,$		;
 	
	MOV	A,R7
QUEBRADOS:
	CALL	delay0_056Ms		
	DJNZ	ACC,QUEBRADOS	

negativo:
	CLR	PWM
	MOV	R2,#0FFH	;
	DJNZ	R2,$		;512US
	MOV	R2,#056H	;
	DJNZ	R2,$		;88US
AUXn:
	MOV	R2,#11H		;
	CALL	DELAY1MS	;
	DJNZ	R2,AUXn		;17MS

	MOV	A,R6
QUEBRADOS2:
	CALL	delay0_056Ms		
	DJNZ	ACC,QUEBRADOS2	
	
	
	RET

INCREMENTA:
	MOV 	ACC,R7
	INC	ACC
	MOV	R7, ACC
	
	MOV	A,R6
	SUBB	A,#01H
	MOV	R6,A
	
	RET


	
delay1Ms:						;1MS= 1000uc
	
	Mov 	R0,#0f7h			;1000uc totais de ciclos de maquina 
	Mov 	R1,#0f8h
	djnz	R0,$	
	djnz	R1,$
	ret
	
delay0_056Ms:					;subtrai dois alem do total por causa do jmp no complemente
	mov	r0,#18h
	djnz	r0,$
	ret

	END